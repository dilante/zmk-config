/*
 * Copyright (c) 2020 ZMK Contributors
 *
 * SPDX-License-Identifier: MIT
 */

#include "charybdis.dtsi"

	// -----------------------------------------------------------------------------------------
	// PCB			MCU			Label		Pin
	// C3			C3			009			10
	// X			R1			031			21
	// C2	  		C2			029			20
	// X			C1			002			19
	// R1			R2			115			18
	// 
	// R3			R4			022			4
	// R2			R3			024			5
	// C4			C4			100			6
	// C5			C5			011			7
	// C6			C6			104			8
	// R4			R5			106			9
	// -----------------------------------------------------------------------------------------

&kscan0 {
	col-gpios
		= <&pro_micro 20 (GPIO_ACTIVE_HIGH | GPIO_PULL_DOWN)>
		, <&pro_micro 10 (GPIO_ACTIVE_HIGH | GPIO_PULL_DOWN)>
		, <&pro_micro 6 (GPIO_ACTIVE_HIGH | GPIO_PULL_DOWN)>
		, <&pro_micro 7 (GPIO_ACTIVE_HIGH | GPIO_PULL_DOWN)>
		, <&pro_micro 8 (GPIO_ACTIVE_HIGH | GPIO_PULL_DOWN)>
		;
};